## simple-espreseif-webserver/main/Kconfig.projbuild
```kconfig
menu "WIFI"

  config SSID
    string "SSID"
    default "MY SSID"
  
  config PASSWORD
    string "PASSWORD"
    default "MY PASSWORD"

endmenu
```
